## boards/shields/hsv/Kconfig.defconfig
```kconfig
# Copyright (c) 2022 The ZMK Contributors
# SPDX-License-Identifier: MIT

# Sets some initial defaults when build keyboard

if SHIELD_HSV_LEFT

config ZMK_KEYBOARD_NAME
    default "Hillside View"

config ZMK_SPLIT_ROLE_CENTRAL
    default y

config ZMK_USB
    default y

endif # SHIELD_HSV_LEFT

if SHIELD_HSV_LEFT || SHIELD_HSV_RIGHT

config ZMK_SPLIT
    default y

config ZMK_DISPLAY
    select LV_FONT_UNSCII_16

if ZMK_POINTER

config I2C
  default y

endif # ZMK_MOUSE

if ZMK_DISPLAY

config ZMK_DISPLAY_BLANK_ON_IDLE
  default n

config SPI
    default y

config LS0XX
    default y

config LV_Z_BITS_PER_PIXEL
    default 1

choice LV_COLOR_DEPTH
    default LV_COLOR_DEPTH_1
endchoice

endif # ZMK_DISPLAY

if LVGL

config LV_Z_VDB_SIZE
    default 64

config LV_DPI_DEF
    default 148

config LV_Z_BITS_PER_PIXEL
    default 1

choice LV_COLOR_DEPTH
    default LV_COLOR_DEPTH_1

endchoice

endif # LVGL

endif # SHIELD_HSV_LEFT || SHIELD_HSV_RIGHT
```

## boards/shields/hsv/Kconfig.shield
```kconfig
# Copyright (c) 2022 The ZMK Contributors
# SPDX-License-Identifier: MIT

config SHIELD_HSV_LEFT
    def_bool $(shields_list_contains,hsv_left)

config SHIELD_HSV_RIGHT
    def_bool $(shields_list_contains,hsv_right)
```
